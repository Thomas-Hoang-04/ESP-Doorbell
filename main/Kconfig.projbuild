## main/Kconfig.projbuild
```kconfig
menu "Doorbell Configuration"

    menu "WiFi Configuration"
        config WIFI_SSID
            string "WiFi SSID"
            help
                SSID (network name) for the example to connect to.

        config WIFI_PASSWORD
            string "WiFi Password"
            help
                WiFi password (WPA or WPA2) for the example to use.

        config WIFI_MAXIMUM_RETRY
            int "Maximum retry"
            default 5
            help
                Set the Maximum retry to avoid station reconnecting to the AP unlimited when the AP is really inexistent.
    endmenu

    menu "WebSocket Streaming"
        config WS_STREAM_URI
            string "WebSocket Server URI"
            default "ws://localhost:8080/ws/stream/inbound"
            help
                WebSocket server URI for streaming. Device ID appended automatically.
                Use ws:// for dev (plain), wss:// for prod (SSL auto-enabled).

        config WS_STREAM_VIDEO_QUEUE_SIZE
            int "Video frame queue depth"
            default 24
            range 5 50
            help
                Number of video frames to buffer (24 = 1 second at 24fps).

        config WS_STREAM_AUDIO_QUEUE_SIZE
            int "Audio frame queue depth"
            default 50
            range 10 100
            help
                Number of audio frames to buffer.

        config WS_STREAM_RECONNECT_TIMEOUT_MS
            int "Reconnection timeout (ms)"
            default 5000
            range 1000 60000
            help
                Time to wait before attempting reconnection.
    endmenu

    menu "MQTT Configuration"
        config MQTT_BROKER_URL
            string "MQTT Broker URL"
            default "mqtts://doorbell-thomas.site"
            help
                URL of the broker to connect to (use mqtts:// for SSL, mqtt:// for MQTT)

        config MQTT_BROKER_PORT
            int "MQTT Broker Port"
            range 1 65535
            default 8883
            help
                Port of the MQTT broker to use (1883 for MQTT, 8883 for MQTTS)

        choice MQTT_AUTH_METHOD
            prompt "MQTT Authentication Method"
            default MQTT_AUTH_USERNAME_PASSWORD
            help
                Choose the authentication method for MQTT connection

            config MQTT_AUTH_USERNAME_PASSWORD
                bool "Username and Password"
                help
                    Use traditional username and password authentication

            config MQTT_AUTH_ACCESS_TOKEN
                bool "Access Token"
                help
                    Use access token authentication (ThingsBoard style)
        endchoice

        config MQTT_USERNAME
            string "MQTT Username"
            depends on MQTT_AUTH_USERNAME_PASSWORD
            help
                MQTT username for authentication

        config MQTT_PASSWORD
            string "MQTT Password"
            depends on MQTT_AUTH_USERNAME_PASSWORD
            help
                MQTT password for authentication

        config MQTT_ACCESS_TOKEN
            string "MQTT Access Token"
            depends on MQTT_AUTH_ACCESS_TOKEN
            help
                Access token for MQTT authentication (used as username, password left empty)

        menu "Topics"
            config MQTT_STREAM_CONTROL_TOPIC
                string "Stream Control Topic"
                default "doorbell/%s/stream"
                help
                    MQTT topic for receiving stream control commands.
                    %s will be replaced with device ID.
                    Expected payload: {"action":"start_stream"} or {"action":"stop_stream"}

            config MQTT_HEARTBEAT_TOPIC
                string "Heartbeat Publish Topic"
                default "doorbell/%s/heartbeat"
                help
                    MQTT topic for publishing heartbeat messages.
                    %s will be replaced with device ID (MQTT_CLIENT_ID).

            config MQTT_BELL_EVENT_TOPIC
                string "Bell Event Publish Topic"
                default "doorbell/%s/event/bell"
                help
                    MQTT topic for publishing bell press events.
                    %s will be replaced with device ID (MQTT_CLIENT_ID).

            config MQTT_SETTINGS_TOPIC
                string "Settings Control Topic"
                default "doorbell/%s/settings"
                help
                    MQTT topic for receiving device settings commands.
                    %s will be replaced with device ID.
                    Expected payload: {"action":"set_chime","chime_index":1}
        endmenu
    endmenu

    menu "Capture Settings"
        config RECORDING_RETENTION_HOURS
            int "Recording retention (hours)"
            default 24
            range 1 168
            help
                Number of hours to keep recordings on the SD card before deleting.
                Default is 24 hours. Range is 1 to 168 hours (1 week).
    endmenu

    menu "Heartbeat Settings"
        config MQTT_HEARTBEAT_INTERVAL_SEC
            int "Heartbeat interval (seconds)"
            default 30
            range 5 300
            help
                Interval in seconds between heartbeat messages sent to the backend.
    endmenu

    menu "BLE Provisioning"
        config PROV_DEVICE_NAME_PREFIX
            string "Device Name Prefix"
            default "DOORBELL_"
            help
                Prefix for BLE device name during provisioning.
                MAC address suffix will be appended.

        config PROV_TIMEOUT_SEC
            int "Provisioning Timeout (seconds)"
            default 300
            range 60 3600
            help
                 Timeout for BLE provisioning. Device will restart if not provisioned within this time.

        config PROV_ERASE_ON_FACTORY_RESET
            bool "Erase WiFi credentials on factory reset"
            default y
            help
                If enabled, WiFi credentials will be erased when factory reset is triggered.

        config PROV_DEVICE_MODEL
            string "Device Model"
            default "ESP32-Doorbell"
            help
                Device model string sent during provisioning.

        config PROV_FIRMWARE_VERSION
            string "Firmware Version"
            default "1.0.0"
            help
                Firmware version string sent during provisioning.
    endmenu
endmenu
```
